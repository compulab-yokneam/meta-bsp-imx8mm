## conf/machine/compulab-imx8mm.inc
```bitbake
MACHINEOVERRIDES =. "imx-boot-container:mx8:mx8m:mx8mm:compulab-mx8mm:"

SOC_DEFAULT_WKS_FILE = "imx-imx-boot-bootpart.wks.in"

require conf/machine/include/imx-base.inc
require conf/machine/include/arm/armv8a/tune-cortexa53.inc

MACHINE_FEATURES += " pci wifi bluetooth "

IMX_DEFAULT_BOOTLOADER:use-mainline-bsp = "u-boot-compulab"
IMX_DEFAULT_BOOTLOADER:use-nxp-bsp = "u-boot-compulab"

SPL_BINARY = "spl/u-boot-spl.bin"

# Set DDR FIRMWARE
DDR_FIRMWARE_NAME = "lpddr4_pmu_train_1d_imem.bin lpddr4_pmu_train_1d_dmem.bin lpddr4_pmu_train_2d_imem.bin lpddr4_pmu_train_2d_dmem.bin"

# Set imx-mkimage boot target
IMXBOOT_TARGETS = "flash_evk"

# Set Serial console
SERIAL_CONSOLES = "115200;ttymxc2"

IMAGE_BOOTLOADER = "imx-boot"

BOOT_SPACE = "65536"

LOADADDR = ""
UBOOT_SUFFIX = "bin"
UBOOT_MAKE_TARGET = ""
IMX_BOOT_SEEK = "33"

MACHINE_FIRMWARE:append = " firmware-cypress linux-firmware-ax200"

MACHINE_FIRMWARE:remove = "linux-firmware-ath10k"

DEFAULTTUNE:mx8mm-nxp-bsp = "aarch64"

# Optee parameters
OPTEEMACHINE:iot-gate-imx8 = "imx-mx8mm_cl_iot_gate"
OPTEEMACHINE:mcm-imx8m-mini = "imx-mx8mm_cl_iot_gate"
OPTEEMACHINE:ucm-imx8m-mini = "imx-mx8mm_cl_iot_gate"
OPTEE_BIN_EXT = "8mm"
# OPTEE_PLATFORM_FLAVOR = "mx8mm_cl_iot_gate"
# PLATFORM_FLAVOR = "${OPTEE_PLATFORM_FLAVOR}"
# PLATFORM_FLAVOR:iot-gate-imx8 = "${OPTEE_PLATFORM_FLAVOR}"
# PLATFORM_FLAVOR:mcm-imx8m-mini = "${OPTEE_PLATFORM_FLAVOR}"
# PLATFORM_FLAVOR:ucm-imx8m-mini = "${OPTEE_PLATFORM_FLAVOR}"
TEE_LOAD_ADDR = "0x56000000"

ATF_MACHINE_NAME = "bl31-imx8mm.bin"
PLATFORM = "imx8mm"
PLATFORM = "${OPTEE_PLATFORM_FLAVOR}"
SOC_TARGET = "iMX8MM"
IMX_BOOT_SOC_TARGET = "iMX8MM"

IMAGE_INSTALL:append = " \
	kernel-image \
	kernel-modules \
	kernel-devicetree \
"

PREFERRED_PROVIDER_virtual/kernel:compulab-mx8mm = "linux-compulab"
PREFERRED_PROVIDER_virtual/bootloader:compulab-mx8mm = "u-boot-compulab"
PREFERRED_PROVIDER_linux-imx-mfgtool:compulab-mx8mm = "linux-compulab-mfgtool"
PREFERRED_PROVIDER_linux-compulab-mfgtool:compulab-mx8mm = "linux-compulab-mfgtool"

# For the kernel module nxp89xx
MACHINE_FIRMWARE:append = " linux-firmware-nxp89xx "
IMAGE_INSTALL:append = " nxp-wlan-sdk  kernel-module-nxp-wlan"
```

## conf/machine/cpl-imx8m-mini.inc
```bitbake
MACHINEOVERRIDES =. "mx8:mx8m:mx8mm:"

require conf/machine/include/imx-base.inc
require conf/machine/include/arm/arch-arm64.inc

MACHINE_FEATURES += " pci wifi bluetooth optee "

SPL_BINARY = "spl/u-boot-spl.bin"

# Set DDR FIRMWARE
DDR_FIRMWARE_NAME = "lpddr4_pmu_train_1d_imem.bin lpddr4_pmu_train_1d_dmem.bin lpddr4_pmu_train_2d_imem.bin lpddr4_pmu_train_2d_dmem.bin"

# Set imx-mkimage boot target
IMXBOOT_TARGETS = "flash_evk"

# Set Serial console
SERIAL_CONSOLES = "115200;ttymxc2"

IMAGE_BOOTLOADER = "imx-boot"

BOOT_SPACE = "65536"

LOADADDR = ""
UBOOT_SUFFIX = "bin"
UBOOT_MAKE_TARGET = ""
IMX_BOOT_SEEK = "33"

OPTEE_BIN_EXT = "8mm"

MACHINE_FIRMWARE += "firmware-imx-brcm"
MACHINE_FIRMWARE += "firmware-imx-iwlwifi"
MACHINE_FIRMWARE_remove = "linux-firmware-ath10k"

DEFAULTTUNE_mx8mm = "aarch64"

IMAGE_INSTALL_append = " \
	kernel-image \
	kernel-modules \
	kernel-devicetree \
"
```

## conf/machine/iot-gate-imx8.conf
```bitbake
#@TYPE: Machine
#@NAME: CompuLab ucm-imx8m-mini Evaluation Kit
#@SOC: i.MX8MM
#@DESCRIPTION: Machine configuration for CompuLab ucm-imx8m-miniEVK
#@MAINTAINER: compulab@compulab.co.il

require compulab-imx8mm.inc

KERNEL_DEVICETREE = "compulab/ucm-imx8m-mini.dtb "
KERNEL_DEVICETREE += "compulab/sb-iotgimx8.dtb "
KERNEL_DEVICETREE += "compulab/sb-iotgimx8-can.dtb "
KERNEL_DEVICETREE += "compulab/sb-iotgimx8-ied.dtb "
KERNEL_DEVICETREE += "compulab/sb-iotgimx8-ied-m4.dtb "
KERNEL_DEVICETREE += "compulab/sb-iotgimx8-poed.dtb "
KERNEL_DEVICETREE += "compulab/sb-iotgimx8-poedv2.dtb "
KERNEL_DEVICETREE += "compulab/sb-iotgimx8-ied-wakeup.dtb "

UBOOT_CONFIG ??= "sd"
UBOOT_CONFIG[sd] = "iot-gate-imx8_defconfig,sdcard"
UBOOT_CONFIG[mfgtool] = "iot-gate-imx8_defconfig"

# Set u-boot DTB
UBOOT_DTB_NAME = "iot-gate-imx8.dtb"

# Prefered components
PREFERRED_PROVIDER_virtual/kernel_mx8mm = "linux-compulab"
PREFERRED_PROVIDER_virtual/bootloader_mx8mm = "u-boot-compulab"

# Block recipes
BBMASK += "meta-compulab/recipes-bsp/u-boot"

# Optee parameters
OPTEE_PLATFORM_FLAVOR = "mx8mm_cl_iot_gate"
PLATFORM_FLAVOR:iot-gate-imx8 = "${OPTEE_PLATFORM_FLAVOR}"
TEE_LOAD_ADDR = "0x56000000"

CL_RELEASE = '3.1.5'
```

## conf/machine/mcm-imx8m-mini.conf
```bitbake
#@TYPE: Machine
#@NAME: CompuLab mcm-imx8m-mini Evaluation Kit
#@SOC: i.MX8MM
#@DESCRIPTION: Machine configuration for CompuLab ucm-imx8m-miniEVK
#@MAINTAINER: compulab@compulab.co.il

require cpl-imx8m-mini.inc

KERNEL_DEVICETREE = "compulab/mcm-imx8m-mini.dtb "
KERNEL_DEVICETREE += "compulab/mcm-imx8m-mini-thermal.dtb "
KERNEL_DEVICETREE += "compulab/mcm-imx8m-mini-m4.dtb "
KERNEL_DEVICETREE += "compulab/sbc-mcm-imx8m-mini.dtb "
KERNEL_DEVICETREE += "compulab/sbc-mcm-imx8m-mini-rs485.dtb "

UBOOT_CONFIG ??= "sd"
UBOOT_CONFIG[sd] = "mcm-imx8m-mini_defconfig,sdcard"
UBOOT_CONFIG[mfgtool] = "mcm-imx8m-mini_defconfig"

# Set u-boot DTB
UBOOT_DTB_NAME = "mcm-imx8m-mini.dtb"


PLATFORM_FLAVOR_mcm-imx8m-mini = "mx8mmevk"
```

## conf/machine/ucm-imx8m-mini.conf
```bitbake
#@TYPE: Machine
#@NAME: CompuLab ucm-imx8m-mini Evaluation Kit
#@SOC: i.MX8MM
#@DESCRIPTION: Machine configuration for CompuLab ucm-imx8m-miniEVK
#@MAINTAINER: compulab@compulab.co.il

require compulab-imx8mm.inc
require murata-2el.inc

KERNEL_DEVICETREE = "compulab/ucm-imx8m-mini.dtb "
KERNEL_DEVICETREE += "compulab/ucm-imx8m-mini-thermal.dtb "
KERNEL_DEVICETREE += "compulab/ucm-imx8m-mini-rev1.4.dtb "

UBOOT_CONFIG ??= "sd"
UBOOT_CONFIG[sd] = "ucm-imx8m-mini_defconfig,sdcard"
UBOOT_CONFIG[mfgtool] = "ucm-imx8m-mini_defconfig"

# Set u-boot DTB
UBOOT_DTB_NAME = "ucm-imx8m-mini.dtb"

CL_RELEASE = '4.0.0'
IMAGE_LINK_NAME = "${MACHINE}"
```

## meta-bsp-imx8mm/conf/layer.conf
```bitbake
# We have a conf and classes directory, append to BBPATH
BBPATH .= ":${LAYERDIR}"

# We have a recipes directory containing .bb and .bbappend files, add to BBFILES
BBFILES += "${LAYERDIR}/recipes-*/*/*.bb \
            ${LAYERDIR}/recipes-*/*/*.bbappend"

BBFILE_COLLECTIONS += "compulab-bsp"
BBFILE_PATTERN_compulab-bsp := "^${LAYERDIR}/"
BBFILE_PRIORITY_compulab-bsp = "9"
```

## recipes-bsp/u-boot/compulab/imx8mm/ucm-imx8m-mini_defconfig
```kconfig
CONFIG_ARM=y
CONFIG_ARCH_IMX8M=y
CONFIG_SYS_TEXT_BASE=0x40200000
CONFIG_SPL_GPIO_SUPPORT=y
CONFIG_SYS_MALLOC_F_LEN=0x2000
CONFIG_SECURE_BOOT=y
CONFIG_TARGET_UCM_IMX8M_MINI=y
CONFIG_SPL_MMC_SUPPORT=y
CONFIG_IMX_OPTEE=y
# CONFIG_CMD_DEKBLOB is not set
CONFIG_DEFAULT_DEVICE_TREE="ucm-imx8m-mini"
CONFIG_LOCALVERSION="-ucm-imx8m-mini-1.0"
CONFIG_FIT=y
CONFIG_SPL_LOAD_FIT=y
CONFIG_SYS_EXTRA_OPTIONS="IMX_CONFIG=arch/arm/mach-imx/spl_sd.cfg,SPL_TEXT_BASE=0x7E1000"
CONFIG_DEFAULT_FDT_FILE="ucm-imx8m-mini.dtb"
CONFIG_ARCH_MISC_INIT=y
CONFIG_SPL=y
CONFIG_SPL_BOARD_INIT=y
CONFIG_HUSH_PARSER=y
CONFIG_FASTBOOT=y
CONFIG_FSL_FASTBOOT=y
CONFIG_FASTBOOT_BUF_ADDR=0x42800000
CONFIG_FASTBOOT_BUF_SIZE=0x40000000
CONFIG_FASTBOOT_FLASH=y
CONFIG_FASTBOOT_FLASH_MMC_DEV=0
CONFIG_CMD_BOOTZ=y
CONFIG_CMD_EEPROM=y
CONFIG_CMD_EEPROM_LAYOUT=y
CONFIG_CMD_MEMINFO=y
CONFIG_CMD_MEMTEST=y
CONFIG_CMD_GPIO=y
CONFIG_CMD_I2C=y
CONFIG_CMD_CACHE=y
# CONFIG_CMD_LED is not set
CONFIG_CMD_REGULATOR=y
# CONFIG_CMD_HASH is not set
CONFIG_CMD_EXT2=y
CONFIG_CMD_EXT4=y
CONFIG_CMD_FAT=y
CONFIG_CMD_FS_GENERIC=y
CONFIG_EFI_PARTITION=y
CONFIG_PARTITION_TYPE_GUID=y
CONFIG_OF_CONTROL=y
CONFIG_ENV_IS_IN_MMC=y
CONFIG_IMX8M_LPDDR4=y
CONFIG_DM_GPIO=y
CONFIG_SYS_I2C_MXC=y
CONFIG_LED=y
CONFIG_LED_STATUS=y
CONFIG_LED_STATUS_GPIO=y
CONFIG_LED_STATUS0=y
CONFIG_LED_STATUS_BIT=12
CONFIG_DM_MMC=y
CONFIG_DM_SPI_FLASH=y
CONFIG_SPI_FLASH=y
CONFIG_SPI_FLASH_STMICRO=y
CONFIG_DM_ETH=y
CONFIG_PINCTRL=y
CONFIG_PINCTRL_IMX8M=y
CONFIG_DM_REGULATOR=y
CONFIG_DM_REGULATOR_FIXED=y
CONFIG_DM_REGULATOR_GPIO=y
CONFIG_DM_SPI=y
CONFIG_DM_THERMAL=y
CONFIG_USB=y
CONFIG_DM_USB=y
CONFIG_USB_EHCI_HCD=y
CONFIG_USB_GADGET=y
CONFIG_USB_GADGET_MANUFACTURER="FSL"
CONFIG_USB_GADGET_VENDOR_NUM=0x0525
CONFIG_USB_GADGET_PRODUCT_NUM=0xa4a5
CONFIG_SDP_LOADADDR=0x40400000
CONFIG_USB_HOST_ETHER=y
CONFIG_USB_ETHER_ASIX88179=y
```
