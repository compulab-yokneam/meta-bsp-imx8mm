## conf/layer.conf
```bitbake
# We have a conf and classes directory, append to BBPATH
BBPATH .= ":${LAYERDIR}"

# We have a recipes directory containing .bb and .bbappend files, add to BBFILES
BBFILES += "${LAYERDIR}/recipes-*/*/*.bb \
            ${LAYERDIR}/recipes-*/*/*.bbappend"

BBFILE_COLLECTIONS += "compulab-bsp-imx8mm"
BBFILE_PATTERN_compulab-bsp-imx8mm := "^${LAYERDIR}/"
BBFILE_PRIORITY_compulab-bsp-imx8mm = "9"

BBMASK += "meta-compulab/recipes-xfce"
BBMASK += "meta-compulab/recipes-kernel"
BBMASK += "meta-compulab/recipes-graphics"
BBMASK += ".*boundary.*"
BBMASK += "meta-imx/meta-bsp/recipes-kernel/kernel-modules/kernel-module-nxp89xx.bb"

CORE_IMAGE_EXTRA_INSTALL += " kernel-modules "
CORE_IMAGE_EXTRA_INSTALL += "${@bb.utils.contains('DISTRO_CODENAME', 'dunfell', 'firmware-imx-sdma-imx7d', 'firmware-imx-sdma', d)}"

DISTRO_FEATURES_append = " bluez5"

HOSTTOOLS += " git-lfs "
HOSTTOOLS += " bison "

LAYERSERIES_COMPAT_compulab-bsp-imx8mm = "sumo thud warrior zeus dunfell hardknott"
```

## conf/machine/murata-2el.inc
```bitbake
# For the kernel module nxp-wlan 
IMAGE_INSTALL_append = " nxp-wlan-sdk  kernel-module-nxp-wlan"
CORE_IMAGE_EXTRA_INSTALL += " firmware-nxp-wifi-nxpiw612-sdio " 
#MACHINE_FIRMWARE_append = " firmware-nxp-wifi-nxpiw612-sdio "
MACHINE_FIRMWARE_remove = "linux-firmware-nxp89xx kernel-module-nxp89xx "
IMAGE_INSTALL_append = " kernel-module-nxp-wlan "
PREFERRED_RPROVIDER_linux-firmware-nxpiw612-sdio = "firmware-nxp-wifi"
MACHINE_FEATURES += " nxpiw612-sdio "
```

## conf/machine/sbc-minimax-mcm-imx8mm.conf
```bitbake
#@TYPE: Machine
#@NAME: CompuLab SBC-MINIMAX MCM-iMX8MM
#@SOC: i.MX8MM
#@DESCRIPTION: Machine configuration for the CompuLab SBC-MINIMAX carrier with MCM-iMX8M-Mini
#@MAINTAINER: compulab@compulab.co.il

require compulab-imx8mm.inc

MACHINEOVERRIDES =. "mcm-imx8m-mini:"

KERNEL_DEVICETREE = "compulab/sbc-mcm-imx8m-mini-minimax.dtb "

PREFERRED_VERSION_linux-compulab = "6.6.3"

UBOOT_CONFIG ??= "sd"
UBOOT_CONFIG[sd] = "sbc-minimax-mcm-imx8mm_defconfig,sdcard"
UBOOT_CONFIG[mfgtool] = "sbc-minimax-mcm-imx8mm_defconfig"
UBOOT_MACHINE_CONFIG = "mcm-imx8m-mini.config"

# Set u-boot DTB
UBOOT_DTB_NAME = "mcm-imx8m-mini.dtb"

# For the NXP IW612 WiFi/BT module
MACHINE_FIRMWARE:append = " firmware-nxp-wifi-nxpiw612-sdio "
PREFERRED_RPROVIDER_linux-firmware-nxpiw612-sdio = "firmware-nxp-wifi"
MACHINE_EXTRA_RRECOMMENDS:append = " nxp-wlan-sdk kernel-module-nxp-wlan btnxpuart-start "

CL_RELEASE = '0.1'
```
